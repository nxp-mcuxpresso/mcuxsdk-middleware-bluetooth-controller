## Kconfig
```kconfig
# Copyright 2025 NXP
# SPDX-License-Identifier: BSD-3-Clause

# SNPS Controller Kconfig file
rsource "Kconfig_snps"

menu "ble_controller"
    config MCUX_COMPONENT_middleware.wireless.ble_controller_nbu
        bool "ble_controller_main"
        select MCUX_COMPONENT_middleware.wireless.ble_controller_threadx
        select MCUX_COMPONENT_middleware.wireless.xcvr
        select MCUX_COMPONENT_middleware.wireless.framework
        select MCUX_COMPONENT_middleware.wireless.framework.sfc
        #select MCUX_COMPONENT_middleware.wireless.framework.platform.lowpower
        select MCUX_COMPONENT_middleware.wireless.framework.platform.ble
        select MCUX_COMPONENT_middleware.wireless.framework.platform.sensors
    config MCUX_COMPONENT_middleware.wireless.ble_controller_nbu_interface
        bool
    config MCUX_COMPONENT_middleware.wireless.ble_controller_nbu_app_base
        bool "ble_controller_app_base"
        select MCUX_COMPONENT_middleware.wireless.ble_controller_threadx
    config MCUX_COMPONENT_middleware.wireless.ble_controller_dtm
        bool "ble_controller_dtm"
    config MCUX_COMPONENT_middleware.wireless.controller_api
        bool "controller_api"
    config MCUX_COMPONENT_middleware.wireless.ble_controller_hadm
        bool "ble_controller_hadm"
        select MCUX_COMPONENT_driver.ltc
        select MCUX_COMPONENT_driver.tpm
        depends on MCUX_HW_BOARD_kw45b41zevk_nbu || MCUX_HW_BOARD_kw47evk || MCUX_HW_BOARD_mcxw72evk || MCUX_HW_BOARD_mcxw71evk || MCUX_HW_BOARD_frdmmcxw72  || MCUX_HW_BOARD_kw43evknbu
    config MCUX_COMPONENT_middleware.wireless.ble_controller_MWS
        bool "ble_controller_MWS"
        depends on !MCUX_HW_BOARD_kw45b41zevk && !MCUX_HW_BOARD_k32w148evk && !MCUX_HW_BOARD_kw45b41zloc
    config MCUX_COMPONENT_middleware.wireless.ble_controller_hybrid_gfsk
        bool "ble_controller_hybrid_gfsk"
    config MCUX_COMPONENT_middleware.wireless.ble_controller_interface
        bool "ble_controller_interface"
    config MCUX_COMPONENT_middleware.wireless.ble_controller_threadx
        bool "threadx_os_library"
    config MCUX_COMPONENT_middleware.wireless.nbu_hosted_lib
        bool "nbu_hosted_lib"
        depends on MCUX_HW_BOARD_kw45b41zevk_nbu
    config MCUX_COMPONENT_middleware.wireless.nbu_hadm_hosted_lib
        bool "nbu_hadm_hosted_lib"
        depends on MCUX_HW_BOARD_kw45b41zevk_nbu
    config MCUX_COMPONENT_middleware.wireless.nbu_xp_hosted_lib
        bool "nbu_xp_hosted_lib"
        depends on MCUX_HW_BOARD_kw45b41zevk_nbu
    config MCUX_COMPONENT_middleware.wireless.nbu_all_hosted_lib
        bool "nbu_all_hosted_lib"
        #depends on MCUX_HW_BOARD_kw47evk || MCUX_HW_BOARD_mcxw72evk
    config MCUX_COMPONENT_middleware.wireless.ble_controller_bin
        bool "ble_controller_bin"
endmenu
```
